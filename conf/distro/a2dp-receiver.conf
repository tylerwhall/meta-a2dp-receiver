## conf/distro/a2dp-receiver.conf
```bitbake
require conf/distro/poky.conf

DISTRO = "a2dp-receiver"

DISTRO_FEATURES_append = " systemd"
VIRTUAL-RUNTIME_init_manager = "systemd"
DISTRO_FEATURES_BACKFILL_CONSIDERED = "sysvinit"

DISTRO_FEATURES_append = " bluetooth bluez5"
DISTRO_FEATURES_remove = "x11"
DISTRO_FEATURES_remove = "zeroconf"

IMAGE_FEATURES += "read-only-rootfs"

DEVTOOLS = "\
	systemd-analyze \
	strace \
	alsa-utils-speakertest \
	alsa-utils-aplay \
"

CORE_IMAGE_EXTRA_INSTALL += "\
	pulseaudio-server \
	pulseaudio-module-bluetooth-discover \
	pulseaudio-module-bluetooth-policy \
	pulseaudio-module-bluez5-discover \
	pulseaudio-module-bluez5-device \
	pulseaudio-module-loopback \
	kernel-modules \
	${DEVTOOLS} \
"
IMAGE_FEATURES += "ssh-server-openssh"
```

## conf/layer.conf
```bitbake
# We have a conf and classes directory, add to BBPATH
BBPATH .= ":${LAYERDIR}"

# We have recipes-* directories, add to BBFILES
BBFILES += "${LAYERDIR}/recipes-*/*/*.bb \
	${LAYERDIR}/recipes-*/*/*.bbappend"

BBFILE_COLLECTIONS += "a2dp-receiver"
BBFILE_PATTERN_a2dp-receiver = "^${LAYERDIR}/"
BBFILE_PRIORITY_a2dp-receiver = "6"
```
